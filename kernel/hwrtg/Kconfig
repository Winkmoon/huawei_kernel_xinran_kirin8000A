## kernel/hwrtg/Kconfig
```kconfig
config HW_RTG_SCHED
	bool "iaware 5.0 rtg sched"
	depends on FRAME_RTG
	default n
	help
	  if set, key thread sched in rtg

config HW_RTG_CONSTRAINT
	bool "constraint the interval of frame rtg"
	depends on FRAME_RTG
	default n
	help
	  if set, change the interval in rtg

config HW_RTG_SCHED_RT_THREAD_LIMIT
	bool "limit the number of RT threads"
	depends on HW_RTG_SCHED
	default n
	help
	  if set, limit the number of RT threads in AUX and Frame rtg.

config HW_RTG_KEY_COMM_MAX_NUM_SET
	bool "set hw rtg key comm max num size"
	depends on FRAME_RTG
	default n
	help
      is set, change max rtg key comm size value

    
```
